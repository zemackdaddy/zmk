## app/boards/arm/bt60/bt60_defconfig
```kconfig
# SPDX-License-Identifier: MIT

CONFIG_SOC_SERIES_NRF52X=y
CONFIG_SOC_NRF52840_QIAA=y
CONFIG_BOARD_BT60=y

# Enable MPU
CONFIG_ARM_MPU=y

# enable GPIO
CONFIG_GPIO=y

# encoder
CONFIG_EC11=y
CONFIG_EC11_TRIGGER_GLOBAL_THREAD=y

CONFIG_USE_DT_CODE_PARTITION=y

CONFIG_MPU_ALLOW_FLASH_WRITE=y
CONFIG_NVS=y
CONFIG_SETTINGS_NVS=y
CONFIG_FLASH=y
CONFIG_FLASH_PAGE_LAYOUT=y
CONFIG_FLASH_MAP=y

CONFIG_ZMK_RGB_UNDERGLOW=y
CONFIG_ZMK_RGB_UNDERGLOW_EXT_POWER=y
CONFIG_ZMK_RGB_UNDERGLOW_ON_START=y
#CONFIG_ZMK_RGB_UNDERGLOW_HUE_START=262
CONFIG_ZMK_RGB_UNDERGLOW_HUE_START=151
# Use the STRIP config specific to the LEDs you're using
CONFIG_WS2812_STRIP=y
CONFIG_BT_CTLR_TX_PWR_PLUS_8=y

CONFIG_LOG=y
CONFIG_ZMK_USB_LOGGING=y
CONFIG_ZMK_LOG_LEVEL_DBG=y
CONFIG_LOG_BUFFER_SIZE=65536
CONFIG_LOG_STRDUP_BUF_COUNT=160
#CONFIG_I2C_LOG_LEVEL_DBG=y
#CONFIG_SPI_LOG_LEVEL_DBG=y

CONFIG_ZMK_APA_LED_STRIP=n
```

## app/boards/arm/rotr/Kconfig.board
```kconfig
#
# Copyright (c) 2021 Polarity Works
# SPDX-License-Identifier: MIT
#

config BOARD_ROTR_LEFT
	bool "rotr_left"
	depends on SOC_NRF52840_QIAA

config BOARD_ROTR_RIGHT
	bool "rotr_right"
	depends on SOC_NRF52840_QIAA
```

## app/boards/arm/rotr/Kconfig.defconfig
```kconfig
#
# Copyright (c) 2021 Polarity Works
# SPDX-License-Identifier: MIT
#

if BOARD_ROTR_LEFT

	config ZMK_KEYBOARD_NAME
	default "Rotr Split"

endif # BOARD_ROTR_LEFT

if BOARD_ROTR_RIGHT

	config ZMK_KEYBOARD_NAME
	default "Rotr Split rt"

endif # BOARD_ROTR_RIGHT


if BOARD_ROTR_LEFT || BOARD_ROTR_RIGHT

config BOARD
	default "rotr"

config ZMK_SPLIT
	default y

config SPI
    bool
    default y

config BT_CTLR
	default BT

config ZMK_BLE
	default y

config ZMK_USB
	default y

if USB

config USB_NRFX
	default y

config USB_DEVICE_STACK
	default y

endif # USB

config ZMK_BATTERY_VOLTAGE_DIVIDER
	default y

config SPI
	default y



endif # BOARD_ROTR_LEFT || BOARD_ROTR_RIGHT
```

## app/boards/arm/rotr/rotr_defconfig
```kconfig
# SPDX-License-Identifier: MIT

CONFIG_SOC_SERIES_NRF52X=y
CONFIG_SOC_NRF52840_QIAA=y
CONFIG_BOARD_ROTR=y

# Enable MPU
CONFIG_ARM_MPU=y

# enable GPIO
CONFIG_GPIO=y

CONFIG_MA730=y
CONFIG_MA730_TRIGGER_GLOBAL_THREAD=y

CONFIG_USE_DT_CODE_PARTITION=y

CONFIG_MPU_ALLOW_FLASH_WRITE=y
CONFIG_NVS=y
CONFIG_SETTINGS_NVS=y
CONFIG_FLASH=y
CONFIG_FLASH_PAGE_LAYOUT=y
CONFIG_FLASH_MAP=y

CONFIG_ZMK_RGB_UNDERGLOW=y
# Use the STRIP config specific to the LEDs you're using
CONFIG_WS2812_STRIP=y
CONFIG_ZMK_RGB_UNDERGLOW_EFF_START=4
CONFIG_BT_CTLR_TX_PWR_PLUS_8=y

CONFIG_LOG=y
CONFIG_ZMK_USB_LOGGING=y
CONFIG_ZMK_LOG_LEVEL_DBG=y
CONFIG_LOG_BUFFER_SIZE=65536
CONFIG_LOG_STRDUP_BUF_COUNT=160
#CONFIG_I2C_LOG_LEVEL_DBG=y
#CONFIG_SPI_LOG_LEVEL_DBG=y


# Turn on USB CDC ACM device
CONFIG_USB=y
CONFIG_USB_DEVICE_STACK=y
CONFIG_USB_CDC_ACM=y
CONFIG_USB_CDC_ACM_RINGBUF_SIZE=1024
CONFIG_USB_CDC_ACM_DEVICE_NAME="CDC_ACM"
CONFIG_USB_CDC_ACM_DEVICE_COUNT=1

# Enable serial console
CONFIG_SERIAL=y
CONFIG_CONSOLE=y
CONFIG_UART_INTERRUPT_DRIVEN=y
CONFIG_UART_LINE_CTRL=y

# Enable USB UART, and set the console device
CONFIG_UART_CONSOLE=y
CONFIG_USB_UART_CONSOLE=y
CONFIG_UART_CONSOLE_ON_DEV_NAME="CDC_ACM_0"
```

## app/boards/arm/rotr/rotr_left_defconfig
```kconfig
#
# Copyright (c) 2021 Polarity Works
# SPDX-License-Identifier: MIT
#

CONFIG_SOC_SERIES_NRF52X=y
CONFIG_SOC_NRF52840_QIAA=y
CONFIG_BOARD_ROTR_LEFT=y
CONFIG_ZMK_BLE=y

CONFIG_ZMK_SPLIT=y
CONFIG_ZMK_SPLIT_ROLE_CENTRAL=y

# Enable MPU
CONFIG_ARM_MPU=y

# enable GPIO
CONFIG_GPIO=y


# Enable SPI
CONFIG_SPI=y

CONFIG_SPI_NRFX=y

# Enable writing to flash
CONFIG_USE_DT_CODE_PARTITION=y
CONFIG_MPU_ALLOW_FLASH_WRITE=y
CONFIG_NVS=y
CONFIG_SETTINGS_NVS=y
CONFIG_FLASH=y
CONFIG_FLASH_PAGE_LAYOUT=y
CONFIG_FLASH_MAP=y

# Enable 32kHz crystal
CONFIG_CLOCK_CONTROL_NRF_K32SRC_XTAL=y
CONFIG_CLOCK_CONTROL_NRF_K32SRC_500PPM=y

CONFIG_ZMK_RGB_UNDERGLOW=y
CONFIG_ZMK_RGB_UNDERGLOW_EXT_POWER=y
CONFIG_ZMK_RGB_UNDERGLOW_ON_START=y
CONFIG_ZMK_RGB_UNDERGLOW_EFF_START=3
CONFIG_ZMK_RGB_UNDERGLOW_AUTO_OFF_IDLE=y

# Use the STRIP config specific to the LEDs you're using
CONFIG_WS2812_STRIP=y
CONFIG_BT_CTLR_TX_PWR_PLUS_8=y

# Turn on logging, and set ZMK logging to debug output
CONFIG_LOG=y
CONFIG_ZMK_USB_LOGGING=y



CONFIG_BUILD_OUTPUT_UF2=y
```

## app/drivers/led/Kconfig
```kconfig
# Copyright (c) 2021 The ZMK Contributors
# SPDX-License-Identifier: MIT

config ZMK_LED_PWM
	bool "PWM LED driver"
	depends on PWM
	help
	  Enable driver for PWM LEDs.

config ZMK_LED_GPIO
	bool "GPIO LED driver"
	depends on GPIO
	help
	  Enable driver for GPIO LEDs.
```

## app/drivers/led_strip/Kconfig.led_strip
```kconfig
# Copyright (c) 2020 Phytec Messtechnik GmbH, Peter Johanson
# SPDX-License-Identifier: Apache-2.0

# apa led strip configuration options

config ZMK_APA_LED_STRIP
	bool "All Point Addressable Led Strip"
	select LED_STRIP
	default y
```

## app/drivers/zephyr/dts/bindings/apa-led-strip/zmk,apa-led-strip-subs.yaml
```yaml
# Copyright (c) 2021 The ZMK Contributors
# SPDX-License-Identifier: MIT

description: All Point Addressable LEDs Strip

compatible: "zmk,apa-led-strip-subs"

properties:

  compatible:
    type: string-array
    required: true
    description: compatible strings

  points:
    type: uint8-array
    required: true
    description: |
      Array of led indices of the underlying led_strip affected by this device
```

## app/drivers/zephyr/dts/bindings/apa-led-strip/zmk,apa-led-strip.yaml
```yaml
# Copyright (c) 2021 The ZMK Contributors
# SPDX-License-Identifier: MIT

description: All Point Addressable LEDs Strip

compatible: "zmk,apa-led-strip"

properties:

  compatible:
    type: string-array
    required: true
    description: compatible strings

  points:
    type: uint8-array
    required: true
    description: |
      Array of led indices of the underlying led_strip affected by this device

  led-strip:
    type: phandle
    required: true
    description: Main led-strip device of which this node specifies a subset
```

## app/dts/bindings/behaviors/zmk,behavior-bottom.yaml
```yaml
# Copyright (c) 2020 The ZMK Contributors
# SPDX-License-Identifier: MIT

description: Keyboard Keysmash Behavior

compatible: "zmk,behavior-bottom"

include: zero_param.yaml

properties:
  delay_ms:
    type: int
    required: true
```

## app/dts/bindings/behaviors/zmk,behavior-default-layer.yaml
```yaml
# Copyright (c) 2020 The ZMK Contributors
# SPDX-License-Identifier: MIT

description: Default Layer

compatible: "zmk,behavior-default-layer"

include: one_param.yaml
```

## app/dts/bindings/behaviors/zmk,behavior-rgb-underglow.yaml
```yaml
# Copyright (c) 2020 The ZMK Contributors
# SPDX-License-Identifier: MIT

description: RGB Underglow Action

compatible: "zmk,behavior-rgb-underglow"

include: two_param.yaml

properties:

  led-strip:
    type: phandle
    required: false
    description: LEDs subset to which the behavior is applied
```

## app/dts/bindings/behaviors/zmk,behavior-sensor-shift-default-layer.yaml
```yaml
# Copyright (c) 2020 The ZMK Contributors
# SPDX-License-Identifier: MIT

description: Sensor rotate shift layer behavior

compatible: "zmk,behavior-sensor-shift-default-layer"

properties:
  label:
    type: string
    required: true
  triggers-per-rotation:
    type: int
    required: false
  "#sensor-binding-cells":
    type: int
    required: false
    const: 0
```

## app/dts/bindings/zmk,keymap.yaml
```yaml
description: |
  Allows defining a keymap composed of multiple layers

compatible: "zmk,keymap"

child-binding:
  description: "A layer to be used in a keymap"

  properties:
    label:
      type: string
      required: false
    bindings:
      type: phandle-array
      required: true
    sensor-bindings:
      type: phandle-array
      required: false
    ledoverride:
      type: boolean
      required: false
    r:
      type: int
      required: false
      default: 255
    g:
      type: int
      required: false
      default: 255
    b:
      type: int
      required: false
      default: 255
```

## app/dts/bindings/zmk,led-indicators.yaml
```yaml
# Copyright (c) 2021 The ZMK Contributors
# SPDX-License-Identifier: MIT

description: LED indicators

compatible: "zmk,led-indicators"

child-binding:
  description: LED indicator

  properties:
    dev:
      type: phandle
      required: true
    index:
      type: int
      required: true
    binding:
      type: int
      required: true
```
