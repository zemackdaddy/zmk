/*
*
* Copyright (c) 2021 Polarity Works
* SPDX-License-Identifier: MIT
*
*/

#include "rotr.dtsi"

/{



	kscan0: kscan {
		compatible = "zmk,kscan-gpio-matrix";
		label = "KSCAN";

		diode-direction = "col2row";
		row-gpios = <&gpio1 13 (GPIO_ACTIVE_HIGH | GPIO_PULL_DOWN)>;
		col-gpios
		= <&gpio0 2 GPIO_ACTIVE_HIGH>
		, <&gpio0 3 GPIO_ACTIVE_HIGH>
		, <&gpio1 15  GPIO_ACTIVE_HIGH>
		;
	};
};

&default_transform {
		col-offset = <3>;
	};
