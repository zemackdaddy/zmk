#include <behaviors.dtsi>
#include <dt-bindings/zmk/keys.h>
#include <dt-bindings/zmk/bt.h>

/ {
    keymap {
    compatible = "zmk,keymap";

    default_layer {
      bindings = <
        &bt BT_CLR &kp CAPSLOCK    &kp N2   &kp SCROLLLOCK   &kp KP_NUM     &kp N5
        >;
    };
  };
};
